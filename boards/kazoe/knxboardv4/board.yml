## boards/kazoe/knxboardv4/board.yml
```yaml
board:
  name: knxboardv4
  full_name: KnxBoard V4
  vendor: kazoe
  socs:
    - name: stm32g491xx
```

## boards/kazoe/knxboardv5/Kconfig.knxboardv5
```kconfig
# Copyright (c) 2024 Klaus Nagel <nagelkl01@gmail.com>
# SPDX-License-Identifier: Apache-2.0

config BOARD_KNXBOARDV5
	select SOC_STM32G491XX
```

## boards/kazoe/knxboardv5/board.yml
```yaml
board:
  name: knxboardv5
  full_name: KnxBoard V5
  vendor: kazoe
  socs:
    - name: stm32g491xx
```
